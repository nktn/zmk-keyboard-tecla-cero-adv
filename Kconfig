## Kconfig
```kconfig
config ZMK_INPUT_PROCESSOR_TYPING_SUPPRESS
    bool "Typing Suppress Input Processor"
    default y
    depends on ZMK_POINTING
    depends on DT_HAS_ZMK_INPUT_PROCESSOR_TYPING_SUPPRESS_ENABLED
    help
      Drops pointing-device events for require-prior-idle-ms after the
      last key press, preventing accidental cursor movement while typing.
```

## boards/shields/tecla_cero_adv/Kconfig.defconfig
```kconfig
if SHIELD_TECLA_CERO_LEFT || SHIELD_TECLA_CERO_RIGHT

config ZMK_KEYBOARD_NAME
    default "cero-adv"

config ZMK_SPLIT
    default y

config SPI
    default y

config INPUT
    default y

config ZMK_MOUSE
    default y

endif
```

## config/west.yml
```yaml
manifest:
  remotes:
    - name: zmkfirmware
      url-base: https://github.com/zmkfirmware
    - name: sekigon-gonnoc
      url-base: https://github.com/sekigon-gonnoc
    - name: cormoran
      url-base: https://github.com/cormoran
    - name: nktn
      url-base: https://github.com/nktn
  projects:
    # dya studio (cormoran のランタイム入力プロセッサ Web UI) の独自 Studio RPC を
    # 使うため、本体 ZMK を cormoran フォーク(v0.3 + custom-studio-protocol)に切替。
    # ※このブランチ限定。main は upstream zmkfirmware/zmk@v0.3 のまま。
    # 再現性・改ざん検知のためブランチ名でなく固定SHAで取得する。
    #   = cormoran/zmk refs/heads/v0.3+custom-studio-protocol の先頭(2026-06-14時点)。
    #   フォークの更新を取り込むときはこのSHAを手動で上げる。
    - name: zmk
      remote: cormoran
      revision: 35bb5dafecd5931c432c74e1b630cf12097671e4
      import: app/west.yml
    # ランタイム入力プロセッサ本体（nktn フォーク）
    # ※ upstream は v0.3対応タグ zmk-v0.3.0.0 を使うが、変更通知に id を載せ
    #   忘れるバグ(編集すると id=0 のプロセッサが上書きされ「left を編集すると
    #   right が left になる」)があるため、それを修正したフォークに固定。
    #   fix-notify-id ブランチの固定 SHA（タグ tip 更新時の取り違え防止）。
    - name: zmk-module-runtime-input-processor
      remote: nktn
      revision: 80bb24984eda41b796d080df16f6f7c084aed04d
    # sekigon-gonnoc 各モジュールも再現性・改ざん検知のため固定SHAで取得する。
    # 各SHAは 2026-07-02 時点の各ブランチ先頭。上流の更新を取り込むときは
    # `git ls-remote https://github.com/sekigon-gonnoc/<repo> refs/heads/<branch>`
    # で新しいSHAを確認し、差分レビューの上で手動で上げる。
    # ※ v0.2 はタグではなくブランチ名（refs/heads/v0.2）なので注意。
    - name: zmk-component-bmp-boost
      remote: sekigon-gonnoc
      import: west.yml
      revision: 8b15ecbb43efe9095e21f5b26fef157faa816f6b # v0.2 ブランチ
    - name: zmk-feature-status-led
      remote: sekigon-gonnoc
      revision: df1e324082c23c748c9ac377a9204535a470b734 # main ブランチ
    - name: zmk-driver-paw3222
      remote: sekigon-gonnoc
      revision: 0e1835c57f88d215ce401b6d0901f361629621fc # torabo-tsuki ブランチ
    - name: zmk-feature-cdc-acm-bootloader-trigger
      remote: sekigon-gonnoc
      revision: 3fc210f840433bb9204a510f3a2c78b4fa11482f # v0.2 ブランチ
    # bmp-boost の west.yml からも main 参照で import されるが、トップレベルの
    # 本 manifest の定義が優先されるため、ここでの固定が有効になる。
    - name: zmk-feature-non-lipo-battery-management
      remote: sekigon-gonnoc
      revision: aa5b958ec6497f6057a1dfce5e731396aaf88374 # main ブランチ
    - name: zmk-driver-iqs7211e
      remote: sekigon-gonnoc
      revision: 436d3c42172abf812ec104521f29384fc02fc50e # master ブランチ
  self:
    path: config
```

## dts/bindings/input_processors/zmk,input-processor-typing-suppress.yaml
```yaml
description: |
  キータイプ中ポインタ抑制 Input Processor。
  直近のキー押下から require-prior-idle-ms 経過するまでの間、
  ポインティングデバイス（トラックボール等）の入力イベントを破棄する。

compatible: "zmk,input-processor-typing-suppress"

properties:
  "#input-processor-cells":
    type: int
    required: true
    const: 0
  require-prior-idle-ms:
    type: int
    required: false
    default: 150
    description: |
      直近のキー押下から N ms 経過するまでは入力イベントを破棄する。
  track-remainders:
    type: boolean
    description: |
      Required by zmk,input-listener for every chained processor.
      This processor only drops or passes events, so it never needs a
      remainder slot — leave unset.
```
