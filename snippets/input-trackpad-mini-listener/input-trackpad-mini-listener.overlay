#include <dt-bindings/input/input-event-codes.h>
#include <input/processors.dtsi>

/ {
    /* X/Y 移動をスクロールに変換（local 接続用）*/
    trackpad_to_scroll_local: trackpad_to_scroll_local {
        compatible = "zmk,input-processor-code-mapper";
        #input-processor-cells = <0>;
        type = <INPUT_EV_REL>;
        map = <INPUT_REL_X INPUT_REL_HWHEEL>
            , <INPUT_REL_Y INPUT_REL_WHEEL>;
    };
};

&trackpad_mini_listener {
    input-processors = <&zip_xy_scaler 1 3 &trackpad_to_scroll_local>;
};
