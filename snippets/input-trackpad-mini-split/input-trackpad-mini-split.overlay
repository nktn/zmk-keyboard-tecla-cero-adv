/{
    split_inputs {
        #address-cells = <1>;
        #size-cells = <0>;

        trackpad_mini_split: trackpad_mini_split@1 {
            compatible = "zmk,input-split";
            reg = <1>;
            device = <&trackpad_mini>;
        };
    };
};
